## imx/meta-bsp/conf/layer.conf
```bitbake
# We have a conf and classes directory, add to BBPATH
BBPATH .= ":${LAYERDIR}"

# We have a packages directory, add to BBFILES
BBFILES += "${LAYERDIR}/recipes-*/*/*.bb \
            ${LAYERDIR}/recipes-*/*/*.bbappend"

BBFILE_COLLECTIONS += "fsl-bsp-release"
BBFILE_PATTERN_fsl-bsp-release := "^${LAYERDIR}"
BBFILE_PRIORITY_fsl-bsp-release = "8"

# NXP BSP is moved from CAF to github
# FIXME: Drop this after meta-freescale is switched to github
PREMIRRORS += "\
    git://source.codeaurora.org/external/imx/ git://github.com/nxp-imx/ \
    git://source.codeaurora.org/external/qoriq/qoriq-components/ git://github.com/nxp-qoriq/qoriq-components_"
```

## imx/meta-bsp/conf/machine/imx6ulzlevk.conf
```bitbake
#@TYPE: Machine
#@NAME: NXP i.MX6ULZ Lite Evaluation Kit
#@SOC: i.MX6ULZ
#@DESCRIPTION: Machine configuration for NXP i.MX6ULZ Lite EVK
#@MAINTAINER: Jun Zhu <junzhu@nxp.com>

MACHINEOVERRIDES =. "mx6:mx6ul:mx6ull:mx6ulz:"

include conf/machine/include/imx-base.inc
include conf/machine/include/tune-cortexa7.inc

MACHINE_FIRMWARE_append = " firmware-imx-epdc"

KERNEL_DEVICETREE = "imx6ulz-lite-evk.dtb \
                     imx6ulz-lite-evk-btwifi.dtb imx6ulz-lite-evk-btwifi-oob.dtb \
"

MACHINE_FEATURES_append = " optee bcm4339 bcm43455"

UBOOT_CONFIG ??= "${@bb.utils.contains('COMBINED_FEATURES', 'optee', 'sd-optee', 'sd', d)}"
UBOOT_CONFIG[qspi1] = "mx6ulz_lite_evk_qspi1_config"
UBOOT_CONFIG[sd] = "mx6ulz_lite_evk_config,sdcard"
UBOOT_CONFIG[sd-optee] = "mx6ulz_lite_evk_optee_config,sdcard"

OPTEE_BIN_EXT = "6ulzlevk"
```

## imx/meta-nxp-mx7ulp/conf/layer.conf
```bitbake
# We have a conf and classes directory, add to BBPATH
BBPATH .= ":${LAYERDIR}"

# We have a packages directory, add to BBFILES
BBFILES += "${LAYERDIR}/recipes-*/*/*.bb \
            ${LAYERDIR}/recipes-*/*/*.bbappend"

BBFILE_COLLECTIONS += "meta-nxp-mx7ulp"
BBFILE_PATTERN_meta-nxp-mx7ulp := "^${LAYERDIR}"
BBFILE_PRIORITY_meta-nxp-mx7ulp = "8"

# Let us add layer-specific bbappends which are only applied when that
# layer is included in our configuration
BBFILES += "${@' '.join('${LAYERDIR}/%s/recipes*/*/*.bbappend' % layer \
               for layer in BBFILE_COLLECTIONS.split())}"

MACHINE_GSTREAMER_1_0_PLUGIN_mx7ulp = "imx-gst1.0-plugin"
MACHINE_SOCARCH_SUFFIX_mx7ulp = "-mx7ulp"
MACHINE_SOCARCH_FILTER_append_mx7ulp = " virtual/libopenvg virtual/libgles1 virtual/libgles2 virtual/egl virtual/mesa virtual/libgl virtual/libg2d"

PREFERRED_PROVIDER_virtual/egl_mx7ulp = "imx-gpu-viv"
PREFERRED_PROVIDER_virtual/libgles1_mx7ulp = "imx-gpu-viv"
PREFERRED_PROVIDER_virtual/libgles2_mx7ulp = "imx-gpu-viv"
PREFERRED_PROVIDER_virtual/libgl_mx7ulp = "imx-gpu-viv"
PREFERRED_PROVIDER_virtual/libg2d_mx7ulp = "imx-gpu-g2d"
MACHINE_HAS_VIVANTE_KERNEL_DRIVER_SUPPORT_mx7ulp = "1"

XSERVER_DRIVER_mx7ulp = "xf86-video-imxfb-vivante"

PREFERRED_VERSION_imx-gpu-viv_mx7ulp = "6.2.0.p2-aarch32"
PREFERRED_VERSION_xf86-video-imxfb-vivante_mx7ulp = "6.2.0.p2"
PREFERRED_VERSION_kernel-module-imx-gpu-viv_mx7ulp = "6.2.0.p2"

PREFERRED_VERSION_imx-gpu-sdk_mx7ulp = "3.1"
PREFERRED_VERSION_imx-gpu-apitrace_mx7ulp = "7.0"
```

## imx/meta-nxp-mx7ulp/conf/machine/imx7ulp_zebu.conf
```bitbake
#@TYPE: Machine
#@NAME: Freescale i.MX7ULP Zebu
#@SOC: i.MX7ULP
#@DESCRIPTION: Machine configuration for NXP i.MX7ULP Zebu
#@MAINTAINER: Lauren Post <Lauren.Post@nxp.com>

require conf/machine/include/imx-base.inc
require conf/machine/include/tune-cortexa7.inc

MACHINE_FEATURES = ""

# comment out for zebu now - later use what is in imx-base.inc
#MACHINE_FEATURES += " pci wifi bluetooth"

SOC_FAMILY = "mx7:mx7ulp"

KERNEL_DEVICETREE = "imx7ulp-zebu.dtb"

UBOOT_CONFIG ??= "basic"
UBOOT_CONFIG[basic] = "mx7ulp_zebu_config"

IMAGE_FSTYPES = "ext3"
```

## imx/meta-sdk/conf/layer.conf
```bitbake
# We have a conf and classes directory, add to BBPATH
BBPATH .= ":${LAYERDIR}"

# We have a packages directory, add to BBFILES
BBFILES += "${LAYERDIR}/recipes-*/*/*.bb \
            ${LAYERDIR}/recipes-*/*/*.bbappend"

BBFILE_COLLECTIONS += "fsl-sdk-release"
BBFILE_PATTERN_fsl-sdk-release := "^${LAYERDIR}"
BBFILE_PRIORITY_fsl-sdk-release = "8"

BBMASK += "meta-freescale/dynamic-layers/qt5-layer/recipes-qt/qt5/qtbase_%.bbappend"
BBMASK += "meta-freescale-distro/recipes-fsl/packagegroups/packagegroup-fsl-tools-gpu-external.bb"

# Create a mirror for unreliable packages
MIRRORS += "http://sourceforge.net/.* http://www.nxp.com/lgfiles/updates/other"

# NXP BSP is moved from CAF to github
# FIXME: Drop this after meta-freescale is switched to github
PREMIRRORS += "\
    git://source.codeaurora.org/external/imx/ git://github.com/nxp-imx/ \
    git://source.codeaurora.org/external/qoriq/qoriq-components/ git://github.com/nxp-qoriq/qoriq-components_"
```
